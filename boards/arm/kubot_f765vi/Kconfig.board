## boards/arm/kubot_f765vi/Kconfig.board
```kconfig
# STM32F767ZI Nucleo board configuration

# Copyright (c) 2019 Roland Ma
# SPDX-License-Identifier: Apache-2.0

config BOARD_KUBOT_F765VI
	bool "Kubot minisumo main board"
	depends on SOC_STM32F765XX
```

## boards/arm/kubot_f765vi/Kconfig.defconfig
```kconfig
# STM32F767ZI Nucleo board configuration

# Copyright (c) 2019 Roland Ma
# SPDX-License-Identifier: Apache-2.0

if BOARD_KUBOT_F765VI

config BOARD
	default "kubot_f765vi"

endif # BOARD_NUCLEO_F767ZI
```

## boards/arm/kubot_f765vi/kubot_f765vi_defconfig
```kconfig
# SPDX-License-Identifier: Apache-2.0

CONFIG_SOC_SERIES_STM32F7X=y
CONFIG_SOC_STM32F769XX=y

# Enable MPU
CONFIG_ARM_MPU=y

# Enable HW stack protection
CONFIG_HW_STACK_PROTECTION=y6

# Enable UART
CONFIG_SERIAL=y

CONFIG_I2C=y
CONFIG_EEPROM_AT24=y
CONFIG_EEPROM_INIT_PRIORITY=75

# Console
CONFIG_USB_DEVICE_STACK=y
CONFIG_USB_DEVICE_PRODUCT="Kubot USB Console"

CONFIG_SERIAL=y
CONFIG_CONSOLE=y
CONFIG_UART_CONSOLE=y
CONFIG_UART_LINE_CTRL=y

# Enable GPIO
CONFIG_GPIO=y

# Enable Clocks
CONFIG_CLOCK_CONTROL=y

# enable pin controller
CONFIG_PINCTRL=y
```

## drivers/led_strip/Kconfig.charlieplex
```kconfig
# Charlieplex RGB LED strip driver interface configuration options
# Copyright (c) 2022, Krzysztof Pochwała
# SPDX-License-Identifier: Apache-2.0

config CHARLIEPLEX_STRIP
	bool "Charlieplexed RGB LED Strip"
	depends on GPIO
	depends on PWM
	depends on LED_PWM
	help
	  Enable driver for charlieplexed LED strip - common RGB electrode connected to gpio, R/G/B electrodes connected to PWM channels 
```

## west.yml
```yaml
# Copyright (c) 2021 Nordic Semiconductor ASA
# SPDX-License-Identifier: Apache-2.0

manifest:
  self:
    path: kubot-software

  remotes:
    - name: zephyrproject-rtos
      url-base: https://github.com/kpochwala

  projects:
    - name: zephyr
      remote: zephyrproject-rtos
      revision: main
      import:
        name-whitelist:
          - cmsis
          - fatfs
          - hal_st
          - hal_stm32
          - zscilib
```
