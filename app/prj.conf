## CMakeLists.txt
```
cmake_minimum_required(VERSION 3.20.0)
set(BOARD kubot_f765vi)
find_package(Zephyr REQUIRED HINTS $ENV{ZEPHYR_BASE})
project(app)
set(CMAKE_EXPORT_COMPILE_COMMANDS ON)

zephyr_library_compile_options(-std=c++17 -g -O0 -Wall -Wextra -Wno-unused-variable -fpermissive -Wno-comment)

target_include_directories(app PRIVATE include)
target_sources(app PRIVATE src/main.c)
target_sources(app PRIVATE src/led_strip_charlieplex.c)
target_sources(app PRIVATE src/robot_sensors/sensor_thread.c)
target_sources(app PRIVATE src/robot_sensors/line_sensor.c)
target_sources(app PRIVATE src/kubot_usb.c)
target_sources(app PRIVATE src/rc5/rc5.c)
target_sources(app PRIVATE src/motor/motor.c)

target_sources(app PRIVATE src/fsm/start_module_fsm.c)
target_sources(app PRIVATE src/fsm/robot_main_states/main_custom_command.c)
target_sources(app PRIVATE src/fsm/robot_main_states/main_power_on.c)
target_sources(app PRIVATE src/fsm/robot_main_states/main_programming.c)
target_sources(app PRIVATE src/fsm/robot_main_states/main_started.c)
target_sources(app PRIVATE src/fsm/robot_main_states/main_stopped_safe.c)
target_sources(app PRIVATE src/fsm/robot_main_states/main_stopped.c)

target_sources(app PRIVATE src/fsm/states/state_power_on.c)
target_sources(app PRIVATE src/fsm/states/state_programming.c)
target_sources(app PRIVATE src/fsm/states/state_started.c)
target_sources(app PRIVATE src/fsm/states/state_stopped.c)
target_sources(app PRIVATE src/fsm/states/state_stopped_safe.c)
target_sources(app PRIVATE src/fsm/states/state_select_sensor.c)
target_sources(app PRIVATE src/fsm/states/state_calibrate_threshold.c)
target_sources(app PRIVATE src/fsm/states/state_calibrate_offset.c)
target_sources(app PRIVATE src/fsm/states/state_calibrate_xtalk.c)

target_sources(app PRIVATE src/eeprom/eeprom_helper.c)
```

## prj.conf
```kconfig
CONFIG_GPIO=y
CONFIG_USB_DEVICE_STACK=y
CONFIG_USB_DEVICE_PRODUCT="Zephyr USB console sample"

CONFIG_SERIAL=y
CONFIG_CONSOLE=y
CONFIG_UART_CONSOLE=y
CONFIG_UART_LINE_CTRL=y

CONFIG_CBPRINTF_FP_SUPPORT=y
CONFIG_STDOUT_CONSOLE=y
CONFIG_I2C=y
CONFIG_SENSOR=y

CONFIG_VL53L0X=y
CONFIG_VL53L0X_PROXIMITY_THRESHOLD=300
CONFIG_VL53L0X_RECONFIGURE_ADDRESS=y
CONFIG_VL53L0X_CONTINOUS_RANGE=y
# CONFIG_VL53L0X_GPIO_IN_RANGE=y

CONFIG_ADC=y
CONFIG_HEAP_MEM_POOL_SIZE=1024

CONFIG_PRINTK=y
CONFIG_SHELL=y
CONFIG_LOG=y
CONFIG_INIT_STACKS=y
CONFIG_THREAD_STACK_INFO=y
CONFIG_KERNEL_SHELL=y
CONFIG_THREAD_MONITOR=y
CONFIG_BOOT_BANNER=y
CONFIG_THREAD_NAME=y
CONFIG_DEVICE_SHELL=y
CONFIG_POSIX_CLOCK=y
CONFIG_DATE_SHELL=y
CONFIG_GPIO_SHELL=y
CONFIG_THREAD_RUNTIME_STATS=y
CONFIG_THREAD_RUNTIME_STATS_USE_TIMING_FUNCTIONS=y
CONFIG_STATS=y
CONFIG_STATS_SHELL=y

CONFIG_EEPROM=y
CONFIG_EEPROM_AT24=y

CONFIG_SENSOR_LOG_LEVEL_DBG=y
CONFIG_SENSOR_LOG_LEVEL_INF=y
CONFIG_SENSOR_LOG_LEVEL_WRN=y
CONFIG_SENSOR_LOG_LEVEL_ERR=y
# CONFIG_FLASH_LOAD_OFFSET=0x20000

# CONFIG_STDOUT_CONSOLE=y
# CONFIG_GPIO=y
# CONFIG_USB_DEVICE_STACK=y
# CONFIG_USB_DEVICE_PRODUCT="Zephyr DFU sample"
# CONFIG_USB_DFU_CLASS=y
# CONFIG_USB_DFU_ENABLE_UPLOAD=y
# CONFIG_FLASH=y
# CONFIG_IMG_MANAGER=y
# CONFIG_FLASH_PAGE_LAYOUT=y
# CONFIG_LOG=y
# CONFIG_USB_DRIVER_LOG_LEVEL_ERR=y
# CONFIG_USB_DEVICE_LOG_LEVEL_ERR=y
# CONFIG_BOOTLOADER_MCUBOOT=y
CONFIG_CPLUSPLUS=y
CONFIG_DEBUG_THREAD_INFO=y
CONFIG_DEBUG_OPTIMIZATIONS=y
CONFIG_NEWLIB_LIBC=y
CONFIG_LIB_CPLUSPLUS=y

CONFIG_PWM=y
CONFIG_LED_PWM=y

CONFIG_MPU9250=y
CONFIG_MPU9250_TRIGGER_NONE=y
CONFIG_MPU9250_MAGN_EN=n

CONFIG_CMSIS_DSP=y
CONFIG_CMSIS_DSP_CONTROLLER=y
CONFIG_USB_CDC_ACM_RINGBUF_SIZE=8192

CONFIG_LOG_DEFAULT_LEVEL=1
CONFIG_SMF=y
CONFIG_EXTRA_EXCEPTION_INFO=y
```

## src/main.c
```c
#include <zephyr/zephyr.h>
#include <zephyr/device.h>
#include <zephyr/sys/printk.h>
#include <zephyr/drivers/gpio.h>
#include <zephyr/drivers/sensor.h>
#include <zephyr/logging/log.h>
#include <stdio.h>


// #include "robot_sensors/sensor_thread.h"
// #include "robot_sensors/line_sensor.h"
// #include "led_strip_charlieplex.h"
#include "eeprom/eeprom_helper.h"

#include "motor/motor.h"
#include "rc5/rc5.h"

#include <zephyr/drivers/gpio.h>
#include <zephyr/drivers/pwm.h>
#include "fsm/start_module_fsm.h"

#include "arm_math.h"
arm_pid_instance_f32 PID;

LOG_MODULE_REGISTER(app);


#define STACKSIZE KB(64)
#define PRIORITY 7

K_SEM_DEFINE(main_semaphore, 0, 1);


void main_thread(void){
    k_sleep(K_MSEC(1000));

    // initialize_kubot_eeprom();

    if(k_sem_take(&main_semaphore, K_MSEC(20000)) != 0){
        LOG_ERR("Unable to acquire main semaphore!");
    } // wait for up to 20s for initialization

    motors_init();
    // set_motors(1.0, 1.0);
    rc5_init();



    while(1){
        k_sleep(K_MSEC(1));

        int command;
        if(rc5_new_command_received(&command)){
            rc5_reset();
            LOG_DBG("RC5 received");
            LOG_DBG("Start bits:   0x%x", rc5_get_start_bits(command));
            LOG_DBG("Toggle bits:  0x%x",rc5_get_toggle_bit(command));
            LOG_DBG("Address bits: 0x%x",rc5_get_address_bits(command));
            LOG_DBG("Command bits: 0x%x",rc5_get_command_bits(command));

            s_obj.rc5_address = rc5_get_address_bits(command);
            s_obj.rc5_command = rc5_get_command_bits(command);
        }

        fsm_start_module_run();

    }
}


K_THREAD_DEFINE(main_thread_id, STACKSIZE, main_thread, NULL, NULL, NULL, PRIORITY+5, 0, 0);





// #ifdef __cplusplus
// }
// #endif
```

## src/main.cpp
```c
#include <zephyr/zephyr.h>
#include <zephyr/device.h>
#include <zephyr/shell/shell.h>
#include <zephyr/sys/printk.h>
#include <zephyr/usb/usb_device.h>
#include <zephyr/drivers/uart.h>
#include <zephyr/drivers/gpio.h>
#include <zephyr/drivers/sensor.h>
#include <zephyr/drivers/adc.h>
#include <zephyr/drivers/eeprom.h>
#include <stdio.h>
#include <zephyr/logging/log.h>

#include <vector>
#include <memory>

#include <zephyr/drivers/pwm.h>

#define DISTANCE_THRESHOLD (CONFIG_VL53L0X_PROXIMITY_THRESHOLD/1000.0)

LOG_MODULE_REGISTER(app);

class SomeClass {

};

std::vector<std::shared_ptr<SomeClass>> someVector;

#ifdef __cplusplus
extern "C" {
#endif

static const struct device *get_eeprom_device(void)
{
	const struct device *dev = DEVICE_DT_GET(DT_ALIAS(eeprom_0));

	if (!device_is_ready(dev)) {
		printk("\nError: Device \"%s\" is not ready; "
		       "check the driver initialization logs for errors.\n",
		       dev->name);
		return NULL;
	}

	printk("Found EEPROM device \"%s\"\n", dev->name);
	return dev;
}


////////////////////////////////////////////////// ADC
#define ADC_RESOLUTION          12
#define ADC_GAIN                ADC_GAIN_1
#define ADC_REFERENCE           ADC_REF_INTERNAL
#define ADC_ACQUISITION_TIME    ADC_ACQ_TIME_DEFAULT
#define BL_RGB_OFFSET           10
#define BL_NUMBER               4

#if !DT_NODE_EXISTS(DT_PATH(zephyr_user)) || \
	!DT_NODE_HAS_PROP(DT_PATH(zephyr_user), io_channels)
#error "No suitable devicetree overlay specified"
#endif

#define DT_SPEC_AND_COMMA(node_id, prop, idx) \
	ADC_DT_SPEC_GET_BY_IDX(node_id, idx),

/* Data of ADC io-channels specified in devicetree. */
static const struct adc_dt_spec adc_channels[] = {
	DT_FOREACH_PROP_ELEM(DT_PATH(zephyr_user), io_channels,
			     DT_SPEC_AND_COMMA)
};

#define LABEL_AND_COMMA(node_id, prop, idx) \
	DT_LABEL(DT_IO_CHANNELS_CTLR_BY_IDX(node_id, idx)),

/* Labels of ADC controllers referenced by the above io-channels. */
static const char *const adc_labels[] = {
	DT_FOREACH_PROP_ELEM(DT_PATH(zephyr_user), io_channels,
			     LABEL_AND_COMMA)
};

////////////////////////////////////////////////// LEDS
#define ALL_LEDS_NUMBER 14
#define PWM_RESOLUTION 0.1

#define PWM_CYCLE_PERIOD_US 10
#define FLASH_TIME_US 250

#define FADE_TIME_US 300000
#define FADE_LOOP_ITERATIONS 5

BUILD_ASSERT(DT_NODE_HAS_COMPAT(DT_CHOSEN(zephyr_console), zephyr_cdc_acm_uart),
         "Console device is not ACM CDC UART device");

static const struct gpio_dt_spec led0 = GPIO_DT_SPEC_GET(DT_ALIAS(led0), gpios);
static const struct gpio_dt_spec led1 = GPIO_DT_SPEC_GET(DT_ALIAS(led1), gpios);

static const struct gpio_dt_spec rgb_k_r = GPIO_DT_SPEC_GET(DT_NODELABEL(rgb_k_r), gpios);
static const struct gpio_dt_spec rgb_k_g = GPIO_DT_SPEC_GET(DT_NODELABEL(rgb_k_g), gpios);
static const struct gpio_dt_spec rgb_k_b = GPIO_DT_SPEC_GET(DT_NODELABEL(rgb_k_b), gpios);

static const struct pwm_dt_spec pwm_red = PWM_DT_SPEC_GET(DT_ALIAS(pwm_red));
static const struct pwm_dt_spec pwm_green = PWM_DT_SPEC_GET(DT_ALIAS(pwm_green));
static const struct pwm_dt_spec pwm_blue = PWM_DT_SPEC_GET(DT_ALIAS(pwm_blue));


static const struct pwm_dt_spec rgb_components[] = {pwm_red, pwm_green, pwm_blue};

static const struct gpio_dt_spec rgb_en_0 = GPIO_DT_SPEC_GET(DT_NODELABEL(rgb_en_0), gpios);
static const struct gpio_dt_spec rgb_en_1 = GPIO_DT_SPEC_GET(DT_NODELABEL(rgb_en_1), gpios);
static const struct gpio_dt_spec rgb_en_2 = GPIO_DT_SPEC_GET(DT_NODELABEL(rgb_en_2), gpios);
static const struct gpio_dt_spec rgb_en_3 = GPIO_DT_SPEC_GET(DT_NODELABEL(rgb_en_3), gpios);
static const struct gpio_dt_spec rgb_en_4 = GPIO_DT_SPEC_GET(DT_NODELABEL(rgb_en_4), gpios);
static const struct gpio_dt_spec rgb_en_5 = GPIO_DT_SPEC_GET(DT_NODELABEL(rgb_en_5), gpios);
static const struct gpio_dt_spec rgb_en_6 = GPIO_DT_SPEC_GET(DT_NODELABEL(rgb_en_6), gpios);
static const struct gpio_dt_spec rgb_en_7 = GPIO_DT_SPEC_GET(DT_NODELABEL(rgb_en_7), gpios);
static const struct gpio_dt_spec rgb_en_8 = GPIO_DT_SPEC_GET(DT_NODELABEL(rgb_en_8), gpios);
static const struct gpio_dt_spec rgb_en_9 = GPIO_DT_SPEC_GET(DT_NODELABEL(rgb_en_9), gpios);

static const struct gpio_dt_spec rgb_en_l0 = GPIO_DT_SPEC_GET(DT_NODELABEL(rgb_en_l0), gpios);
static const struct gpio_dt_spec rgb_en_l1 = GPIO_DT_SPEC_GET(DT_NODELABEL(rgb_en_l1), gpios);
static const struct gpio_dt_spec rgb_en_l2 = GPIO_DT_SPEC_GET(DT_NODELABEL(rgb_en_l2), gpios);
static const struct gpio_dt_spec rgb_en_l3 = GPIO_DT_SPEC_GET(DT_NODELABEL(rgb_en_l3), gpios);


static const struct gpio_dt_spec ir_led = GPIO_DT_SPEC_GET(DT_NODELABEL(ir_led), gpios);

static const struct gpio_dt_spec rgb_enables[] = {rgb_en_0, rgb_en_1, rgb_en_2, rgb_en_3, rgb_en_4, rgb_en_5, rgb_en_6, rgb_en_7, rgb_en_8, rgb_en_9, rgb_en_l3, rgb_en_l2, rgb_en_l0, rgb_en_l1};

// static const struct device *g_eeprom = DEVICE_DT_GET(DT_ALIAS(eeprom_0));
// static const struct device *eeprom = NULL;

static const char* tof_labels[] = {"V0", "V1", "V2", "V3", "V4", "V5", "V6", "V7", "V8", "V9"};
struct rgb {
    float r;
    float g;
    float b;
};

const struct rgb kabot_color = {255/255.0, 0/255.0, 72/255.0};
// const struct rgb kabot_color = {0/255.0, 0/255.0, 72/255.0};
const struct rgb kabot_init = {0/255.0, 0/255.0, 255/255.0};
const struct rgb kabot_warning = {255/255.0, 157/255.0, 0/255.0};
const struct rgb kabot_error = {255/255.0, 0/255.0, 0/255.0};

struct rgb rgbPwmValues[] = {kabot_init,
                             kabot_init,
                             kabot_init,
                             kabot_init,
                             kabot_init,
                             kabot_init,
                             kabot_init,
                             kabot_init,
                             kabot_init,
                             kabot_init,
                             kabot_init,
                             kabot_init,
                             kabot_init,
                             kabot_init};




struct rgb rgbPwmValues2[] = {{0.0, 0.0, 0.0},
                              {0.0, 0.0, 0.0},
                              {0.0, 0.0, 0.0},
                              {0.0, 0.0, 0.0},
                              {0.0, 0.0, 0.0},
                              {0.0, 0.0, 0.0},
                              {0.0, 0.0, 0.0},
                              {0.0, 0.0, 0.0},
                              {0.0, 0.0, 0.0},
                              {0.0, 0.0, 0.0},
                              {0.0, 0.0, 0.0},
                              {0.0, 0.0, 0.0},
                              {0.0, 0.0, 0.0},
                              {0.0, 0.0, 0.0},
                              };

// void flash_leds(struct rgb* enabled_leds, int led_number, int whole_flash_time){

//     for(int currentLedNumber = 0; currentLedNumber < led_number; currentLedNumber++){
//         struct gpio_dt_spec* current_led = &rgb_enables[currentLedNumber];
//         gpio_pin_set_dt(&rgb_components[0], enabled_leds[currentLedNumber].r>0.01);
//         gpio_pin_set_dt(&rgb_components[1], enabled_leds[currentLedNumber].g>0.01);
//         gpio_pin_set_dt(&rgb_components[2], enabled_leds[currentLedNumber].b>0.01);

//         gpio_pin_set_dt(current_led, 1);
//         k_sleep(K_USEC(whole_flash_time / led_number));
//         gpio_pin_set_dt(current_led, 0);
//     }
// }

void set_leds(struct rgb* rgbPwmValues, int led_number) {

        for(int currentLedNumber = 0; currentLedNumber < led_number; currentLedNumber++){
            struct gpio_dt_spec current_led = rgb_enables[currentLedNumber];
            gpio_pin_set_dt(&current_led, 1);

            pwm_set_pulse_dt(&pwm_red, pwm_red.period * rgbPwmValues[currentLedNumber].r);
            pwm_set_pulse_dt(&pwm_green, pwm_green.period * rgbPwmValues[currentLedNumber].g);
            pwm_set_pulse_dt(&pwm_blue, pwm_blue.period * rgbPwmValues[currentLedNumber].b);
            k_sleep(K_USEC(FLASH_TIME_US));
            
            pwm_set_pulse_dt(&pwm_red, 0);
            pwm_set_pulse_dt(&pwm_green, 0);
            pwm_set_pulse_dt(&pwm_blue, 0);
            gpio_pin_set_dt(&current_led, 0);
        }
}
////////////////////////////////////////////////// EEPROM

/*
 * Get a device structure from a devicetree node with alias eeprom0
 */


////////////////////////////////////////////////// THREADS

K_MUTEX_DEFINE(rgb_mutex);


struct printk_data_t {
    void *fifo_reserved; /* 1st word reserved for use by fifo */
    uint32_t adc_value;
};

K_FIFO_DEFINE(printk_fifo);


#define STACKSIZE 1024
#define PRIORITY 7



void led_thread(void){

    for(int i = 0; i < ALL_LEDS_NUMBER; i++){
        gpio_pin_configure_dt(&rgb_enables[i], GPIO_OUTPUT_ACTIVE);
        gpio_pin_set_dt(&rgb_enables[i], 0);
    }

    while(1) {
        if(k_mutex_lock(&rgb_mutex, K_MSEC(100)) == 0){
            set_leds(rgbPwmValues, ALL_LEDS_NUMBER);
            k_mutex_unlock(&rgb_mutex);
        }        
    }
}

void main_thread(void){

    k_sleep(K_MSEC(3000));

    const struct device *eeprom = get_eeprom_device();
    eeprom = get_eeprom_device();
    eeprom = get_eeprom_device();
    eeprom = get_eeprom_device();

    size_t eeprom_size;

    if(eeprom){
        eeprom_size = eeprom_get_size(eeprom);
        LOG_DBG("EEPROM initialized");
    }else{
        LOG_ERR("EEPROM initialization failed");
    }


    // leds 
    
    // for(int i = 0; i < 3; i++){
    //     gpio_pin_configure_dt(&rgb_components[i], GPIO_OUTPUT_ACTIVE);
    //     gpio_pin_set_dt(&rgb_components[i], 1);
    // }

    for(int i = 0; i < ALL_LEDS_NUMBER; i++){
        gpio_pin_configure_dt(&rgb_enables[i], GPIO_OUTPUT_ACTIVE);
        gpio_pin_set_dt(&rgb_enables[i], 1);
    }

    struct pwm_dt_spec pwm_red = PWM_DT_SPEC_GET(DT_ALIAS(pwm_red));
    struct pwm_dt_spec pwm_green = PWM_DT_SPEC_GET(DT_ALIAS(pwm_green));
    struct pwm_dt_spec pwm_blue = PWM_DT_SPEC_GET(DT_ALIAS(pwm_blue));

    if(!device_is_ready(pwm_red.dev)){
        LOG_ERR("PWM init failed.");
    }

    if(!device_is_ready(pwm_green.dev)){
        LOG_ERR("PWM init failed.");
    }

    if(!device_is_ready(pwm_blue.dev)){
        LOG_ERR("PWM init failed.");
    }


    int pwm_ret = 0;

    // pwm_ret = pwm_set_pulse_dt(&pwm_blue, )

    // pwm_ret = pwm_set_dt(&pwm_blue, 10000, 5000);

    pwm_ret = pwm_set_pulse_dt(&pwm_red, pwm_red.period/2);
    if(pwm_ret){
        LOG_ERR("PWM set failed.");
    }

    pwm_ret = pwm_set_pulse_dt(&pwm_green, pwm_green.period/2);
    if(pwm_ret){
        LOG_ERR("PWM set failed.");
    }

    pwm_ret = pwm_set_pulse_dt(&pwm_blue, pwm_blue.period/2);
    if(pwm_ret){
        LOG_ERR("PWM set failed.");
    }


    while(1){
        k_sleep(K_MSEC(1000));
        // if(k_mutex_lock(&rgb_mutex, K_MSEC(100)) == 0) {
        //     rgbPwmValues[3].r = 1.0;
        //     rgbPwmValues[3].g = 1.0;
        //     rgbPwmValues[3].b = 1.0;
        //     k_mutex_unlock(&rgb_mutex);
        // }

        // k_sleep(K_MSEC(1000));

        // if(k_mutex_lock(&rgb_mutex, K_MSEC(100)) == 0) {
        //     rgbPwmValues[3].r = 0.0;
        //     rgbPwmValues[3].g = 0.0;
        //     rgbPwmValues[3].b = 0.0;
        //     k_mutex_unlock(&rgb_mutex);
        // }

        // struct printk_data_t tx_data = { .adc_value = 42 };
        // size_t size = sizeof(struct printk_data_t);
        // char *mem_ptr = k_malloc(size);
        // __ASSERT_NO_MSG(mem_ptr != 0);
        // memcpy(mem_ptr, &tx_data, size);
        // k_fifo_put(&printk_fifo, mem_ptr);

    }
}

void usb_thread(void){
    const struct device *dev = DEVICE_DT_GET(DT_CHOSEN(zephyr_shell_uart));
	if (!device_is_ready(dev) || usb_enable(NULL)) {
		return;
	}
    
    dev = DEVICE_DT_GET(DT_CHOSEN(zephyr_console));
       
    if (usb_enable(NULL)) {
        return;
    }

    /* Poll if the DTR flag was set */
    uint32_t dtr = 0;
    while (!dtr) {
        uart_line_ctrl_get(dev, UART_LINE_CTRL_DTR, &dtr);
        /* Give CPU resources to low priority threads. */
        k_sleep(K_MSEC(100));
    }

    printk("Hello World! %s\n", CONFIG_ARCH);

    while (1) {
        struct printk_data_t *rx_data = k_fifo_get(&printk_fifo, K_FOREVER);
        printk("Adc value: %d\n", rx_data->adc_value);
        k_free(rx_data);
    }

}

void adc_thread(void){

    gpio_pin_configure_dt(&ir_led, GPIO_OUTPUT_ACTIVE);
    gpio_pin_set_dt(&ir_led, 1);

    for(int i = 0; i < BL_NUMBER; i++){
        struct adc_dt_spec *dt_spec = &adc_channels[i];
        struct adc_channel_cfg channel_cfg = {
                .gain             = ADC_GAIN,
                .reference        = ADC_REFERENCE,
                .acquisition_time = ADC_ACQUISITION_TIME,
                .channel_id       = dt_spec->channel_id,
        };
        adc_channel_setup(dt_spec->dev, &channel_cfg);
    }

    int16_t sample_buffer[1];

    struct adc_sequence sequence = {
        .buffer = sample_buffer,
        /* buffer size in bytes, not number of samples */
        .buffer_size = sizeof(sample_buffer),
        .resolution = ADC_RESOLUTION,
        .oversampling = 0,
    };
    
    int adc_readings[BL_NUMBER];

    while(1){
        printk("BL: ");
        for(int i = 0; i < BL_NUMBER; i++){
            struct adc_dt_spec *dt_spec = &adc_channels[i];
            sequence.channels = BIT(dt_spec->channel_id);
            gpio_pin_set_dt(&ir_led, 1);
            k_sleep(K_MSEC(1));
            adc_read(dt_spec->dev, &sequence);
            gpio_pin_set_dt(&ir_led, 0);

            adc_readings[i] = sample_buffer[0];
            adc_read(dt_spec->dev, &sequence);
            adc_readings[i] -= sample_buffer[0];
            printk("BL%4d: %4d ", i, adc_readings[i]);

            if(adc_readings[i] < -10){
                if(k_mutex_lock(&rgb_mutex, K_MSEC(100)) == 0) {
                    rgbPwmValues[BL_RGB_OFFSET + i] = kabot_warning;
                    k_mutex_unlock(&rgb_mutex);
                }
            }else{
                    if(k_mutex_lock(&rgb_mutex, K_MSEC(100)) == 0) {
                    rgbPwmValues[BL_RGB_OFFSET + i] = kabot_color;
                    k_mutex_unlock(&rgb_mutex);
                }
            }
        }
        printk("\n");

        // struct printk_data_t tx_data = { .adc_value = sample_buffer[0] };
        // size_t size = sizeof(struct printk_data_t);
        // char *mem_ptr = k_malloc(size);
        // __ASSERT_NO_MSG(mem_ptr != 0);
        // memcpy(mem_ptr, &tx_data, size);
        // k_fifo_put(&printk_fifo, mem_ptr);

        k_sleep(K_MSEC(1));
    }

}

void fetch_tof(void){

    k_sleep(K_MSEC(1000));

    struct sensor_value values[10];
    struct sensor_value value;
    for(int i = 0; i < 10; i++) {
        // struct device* tof_1 = device_get_binding(DT_LABEL(VL53L0X));
        struct device* tof = device_get_binding(tof_labels[i]);
        
        int retval = 0;
        retval = sensor_sample_fetch(tof);
        
        printk("Sensor:  %s\n", tof_labels[i]);
        
        if(retval != 0){
            if(k_mutex_lock(&rgb_mutex, K_MSEC(100)) == 0) {
                rgbPwmValues[i] = kabot_error;
                k_mutex_unlock(&rgb_mutex);
            }
            continue;
        }
    }

    while(1){
         k_sleep(K_MSEC(1));

        for(int i = 0; i < 10; i++) {
            // struct device* tof_1 = device_get_binding(DT_LABEL(VL53L0X));
            int retval = 0;
            struct device* tof = device_get_binding(tof_labels[i]);
            struct sensor_value value;
            values[i] = value;

            retval = sensor_sample_fetch(tof);
            if(retval != 0){
                if(k_mutex_lock(&rgb_mutex, K_MSEC(100)) == 0) {
                    rgbPwmValues[i] = kabot_warning;
                    k_mutex_unlock(&rgb_mutex);
                }
                printk("Error fetching value from %s error code: %d\n", tof_labels[i], retval);
                continue;
            }
            retval = sensor_channel_get(tof, SENSOR_CHAN_DISTANCE, &value);
            if(retval != 0){
                if(k_mutex_lock(&rgb_mutex, K_MSEC(100)) == 0) {
                    rgbPwmValues[i] = kabot_warning;
                    k_mutex_unlock(&rgb_mutex);
                }
                printk("Error getting value from %s error code: %d\n", tof_labels[i], retval);
                continue;
            }


            struct rgb active = {.r = 1.0, .g = 1.0, .b = 1.0};
            struct rgb inactive = kabot_color;

            if(sensor_value_to_double(&value) < DISTANCE_THRESHOLD){
                if(k_mutex_lock(&rgb_mutex, K_MSEC(100)) == 0) {
                    rgbPwmValues[i] = active;
                    k_mutex_unlock(&rgb_mutex);
                }
            }else{
                if(k_mutex_lock(&rgb_mutex, K_MSEC(100)) == 0) {
                    rgbPwmValues[i] = inactive;
                    k_mutex_unlock(&rgb_mutex);
                }
            }
        }

        printk("Sensor values: ");
        for(int i=0; i<10; i++) {
            printk("%s: ", tof_labels[i]);
            printk("%.3fm ", sensor_value_to_double(&values[i]));
        }
        printk("\n");
    }

    // while(1){
    //     for(int i = 0; i < 5; i++) {
    //         // struct device* tof_1 = device_get_binding(DT_LABEL(VL53L0X));
    //         struct device* tof = device_get_binding(tof_labels[i]);
    //         sensor_sample_fetch(tof);
    //         sensor_channel_get(tof, SENSOR_CHAN_PROX, &value);
    //         printk("distance is %.3fm\n", sensor_value_to_double(&value));
    //     }
    //     k_sleep(K_MSEC(100));
    // }
}

K_THREAD_DEFINE(fetch_tof_id, STACKSIZE, fetch_tof, NULL, NULL, NULL, PRIORITY, 0, 0);
K_THREAD_DEFINE(led_thread_id, STACKSIZE, led_thread, NULL, NULL, NULL, PRIORITY, 0, 0);
// K_THREAD_DEFINE(adc_thread_id, STACKSIZE, adc_thread, NULL, NULL, NULL, PRIORITY+1, 0, 0);
// K_THREAD_DEFINE(main_thread_id, STACKSIZE, main_thread, NULL, NULL, NULL, PRIORITY+5, 0, 0);
// K_THREAD_DEFINE(usb_thread_id, STACKSIZE, usb_thread, NULL, NULL, NULL, PRIORITY+2, 0, 0);




static int cmd_foo(const struct shell *shell, size_t argc, char **argv)
{
	ARG_UNUSED(argc);
	ARG_UNUSED(argv);

	shell_print(shell, "bar");

	return 0;
}
SHELL_CMD_REGISTER(foo, NULL, "This prints bar.", cmd_foo);

static int tof1_handler(const struct shell *shell, size_t argc, char **argv)
{
	ARG_UNUSED(argc);
	ARG_UNUSED(argv);

	shell_print(shell, "tof1_handler");
	return 0;
}

SHELL_SUBCMD_SET_CREATE(sub_tof, (tof, tof1));
SHELL_SUBCMD_ADD((sub_tof), tof1, &sub_tof, "Help for tof1", tof1_handler, 1, 0);
SHELL_CMD_REGISTER(tof, &sub_tof, "Tof calibration commands", NULL);

#ifdef __cplusplus
}
#endif
```

## include/led_strip_charlieplex.h
```c
#pragma once
#include <zephyr/drivers/led_strip.h>

extern const struct led_rgb kabot_active;
extern const struct led_rgb kabot_inactive;
extern const struct led_rgb kabot_color;
extern const struct led_rgb kabot_init;
extern const struct led_rgb kabot_warning;
extern const struct led_rgb kabot_error;
extern const struct led_rgb kabot_ok;
extern const struct led_rgb kabot_off;

// commented out because not thread safe
// int led_strip_update_rgb_impl(const struct device *dev, struct led_rgb *pixels, size_t num_pixels);
// int led_strip_set_led(const struct device *dev, struct led_rgb pixel, size_t number_of_pixel);
void set_led(int number, struct led_rgb color);
void set_led_multi(struct led_rgb* pixels, size_t number_of_pixels, size_t offset);
void set_led_all(struct led_rgb color);
```

## include/main.h
```c
extern struct k_sem main_semaphore;
```

## include/motor.h
```c
#pragma once

extern const float speed_multiplier;

struct vec3f {
    float x;
    float y;
    float z;
};

int motors_init();
int set_motors(float speed_m1, float speed_m2);
int set_motors_vec(struct vec3f* translation, struct vec3f* rotation);
```

## include/rc5.h
```c
#ifndef RC5_H
#define RC5_H

#include <zephyr.h>
#include <zephyr/drivers/gpio.h>

extern struct gpio_dt_spec rc5_decoder;

// stolen from: https://github.com/pinkeen/avr-rc5/blob/master/main.c

#define rc5_get_start_bits(command) ((command & 0x3000) >> 12)
#define rc5_get_toggle_bit(command) ((command & 0x800) >> 11)
#define rc5_get_address_bits(command) ((command & 0x7C0) >> 6)
#define rc5_get_command_bits(command) (command & 0x3F)
#define rc5_get_command_address_bits(command) (command & 0x7FF)

void rc5_init();
void rc5_reset();
bool rc5_new_command_received(int* new_command);

#endif
```

## include/sensor_thread.h
```c
#pragma once
#include <stdbool.h>

#define ALL_SENSORS_NUMBER 10

extern struct k_mutex tof_measurements_mutex;

struct distance_measurement {
    bool in_range;
    unsigned int distance_mm;
    int err;
};

extern struct distance_measurement tof_measurements[];
```

## include/start_module_fsm.h
```c
#pragma once

int fsm_start_module_run();
```

## include/utils.h
```c
#pragma once

struct vec3f {
    float x;
    float y;
    float z;
};
```

## src/eeprom_helper.c
```c
#include "eeprom_helper.h"

#include <zephyr/device.h>
#include <zephyr/drivers/eeprom.h>
#include <zephyr/logging/log.h>

LOG_MODULE_REGISTER(eeprom_helper);

static const struct device *get_eeprom_device(void)
{
	const struct device *dev = DEVICE_DT_GET(DT_ALIAS(eeprom_0));

	if (!device_is_ready(dev)) {
		printk("\nError: Device \"%s\" is not ready; "
		       "check the driver initialization logs for errors.\n",
		       dev->name);
		return NULL;
	}

	LOG_DBG("Found EEPROM device \"%s\"\n", dev->name);
	return dev;
}

struct device* initialize_eeprom(void){
    const struct device *eeprom = get_eeprom_device();
	size_t eeprom_size = 0;
    if(eeprom){
        eeprom_size = eeprom_get_size(eeprom);
        LOG_DBG("EEPROM initialized");
    }else{
        LOG_ERR("EEPROM initialization failed");
    }
	return eeprom;
}
```

## src/kubot_usb.c
```c
#include <zephyr/logging/log.h>
#include <zephyr/shell/shell.h>
#include <zephyr/sys/printk.h>
#include <zephyr/usb/usb_device.h>
#include <zephyr/drivers/uart.h>
#include <zephyr/sys/ring_buffer.h>

#define RING_BUF_SIZE 1024
uint8_t ring_buffer[RING_BUF_SIZE];

struct ring_buf ringbuf;

LOG_MODULE_REGISTER(kabot_usb);

// BUILD_ASSERT(DT_NODE_HAS_COMPAT(DT_CHOSEN(zephyr_console), zephyr_cdc_acm_uart),
//          "Console device is not ACM CDC UART device");

struct printk_data_t {
    void *fifo_reserved; /* 1st word reserved for use by fifo */
    uint32_t adc_value;
};

K_FIFO_DEFINE(printk_fifo);

void usb_thread(void){
    const struct device *dev = DEVICE_DT_GET(DT_CHOSEN(zephyr_shell_uart));
	if (!device_is_ready(dev) || usb_enable(NULL)) {
		return;
	}
    
    dev = DEVICE_DT_GET(DT_CHOSEN(zephyr_console));

    ring_buf_init(&ringbuf, sizeof(ring_buffer), ring_buffer);
       
    if (usb_enable(NULL)) {
        return;
    }



    /* Poll if the DTR flag was set */
    uint32_t dtr = 0;
    while (!dtr) {
        uart_line_ctrl_get(dev, UART_LINE_CTRL_DTR, &dtr);
        /* Give CPU resources to low priority threads. */
        k_sleep(K_MSEC(100));
    }

    printk("Hello World! %s\n", CONFIG_ARCH);

    while (1) {
        struct printk_data_t *rx_data = k_fifo_get(&printk_fifo, K_FOREVER);
        printk("Adc value: %d\n", rx_data->adc_value);
        k_free(rx_data);
    }

}

static int cmd_foo(const struct shell *shell, size_t argc, char **argv)
{
	ARG_UNUSED(argc);
	ARG_UNUSED(argv);

	shell_print(shell, "bar");

	return 0;
}
SHELL_CMD_REGISTER(foo, NULL, "This prints bar.", cmd_foo);

static int tof1_handler(const struct shell *shell, size_t argc, char **argv)
{
	ARG_UNUSED(argc);
	ARG_UNUSED(argv);

	shell_print(shell, "tof1_handler");
	return 0;
}

SHELL_SUBCMD_SET_CREATE(sub_tof, (tof, tof1));
SHELL_SUBCMD_ADD((sub_tof), tof1, &sub_tof, "Help for tof1", tof1_handler, 1, 0);
SHELL_CMD_REGISTER(tof, &sub_tof, "Tof calibration commands", NULL);


#define PRIORITY 9
#define STACKSIZE KB(4)
K_THREAD_DEFINE(usb_thread_id, STACKSIZE, usb_thread, NULL, NULL, NULL, PRIORITY, 0, 0);
```

## src/led_strip_charlieplex.c
```c
#include <zephyr/drivers/pwm.h>
#include <zephyr/drivers/led.h>
#include <zephyr/drivers/gpio.h>
#include <zephyr/logging/log.h>
#include "led_strip_charlieplex.h"

LOG_MODULE_REGISTER(led_strip_charlieplex);
K_MUTEX_DEFINE(rgb_mutex);

////////////////////////////////////////////////// LEDS
#define ALL_LEDS_NUMBER 14
#define PWM_RESOLUTION 0.1

#define PWM_CYCLE_PERIOD_US 10
#define FLASH_TIME_US 250

#define FADE_TIME_US 300000
#define FADE_LOOP_ITERATIONS 5

static const struct pwm_dt_spec pwm_red = PWM_DT_SPEC_GET(DT_ALIAS(pwm_red));
static const struct pwm_dt_spec pwm_green = PWM_DT_SPEC_GET(DT_ALIAS(pwm_green));
static const struct pwm_dt_spec pwm_blue = PWM_DT_SPEC_GET(DT_ALIAS(pwm_blue));

static const struct pwm_dt_spec rgb_components[] = {pwm_red, pwm_green, pwm_blue};

static const struct gpio_dt_spec rgb_en_0 = GPIO_DT_SPEC_GET(DT_NODELABEL(rgb_en_0), gpios);
static const struct gpio_dt_spec rgb_en_1 = GPIO_DT_SPEC_GET(DT_NODELABEL(rgb_en_1), gpios);
static const struct gpio_dt_spec rgb_en_2 = GPIO_DT_SPEC_GET(DT_NODELABEL(rgb_en_2), gpios);
static const struct gpio_dt_spec rgb_en_3 = GPIO_DT_SPEC_GET(DT_NODELABEL(rgb_en_3), gpios);
static const struct gpio_dt_spec rgb_en_4 = GPIO_DT_SPEC_GET(DT_NODELABEL(rgb_en_4), gpios);
static const struct gpio_dt_spec rgb_en_5 = GPIO_DT_SPEC_GET(DT_NODELABEL(rgb_en_5), gpios);
static const struct gpio_dt_spec rgb_en_6 = GPIO_DT_SPEC_GET(DT_NODELABEL(rgb_en_6), gpios);
static const struct gpio_dt_spec rgb_en_7 = GPIO_DT_SPEC_GET(DT_NODELABEL(rgb_en_7), gpios);
static const struct gpio_dt_spec rgb_en_8 = GPIO_DT_SPEC_GET(DT_NODELABEL(rgb_en_8), gpios);
static const struct gpio_dt_spec rgb_en_9 = GPIO_DT_SPEC_GET(DT_NODELABEL(rgb_en_9), gpios);

static const struct gpio_dt_spec rgb_en_l0 = GPIO_DT_SPEC_GET(DT_NODELABEL(rgb_en_l0), gpios);
static const struct gpio_dt_spec rgb_en_l1 = GPIO_DT_SPEC_GET(DT_NODELABEL(rgb_en_l1), gpios);
static const struct gpio_dt_spec rgb_en_l2 = GPIO_DT_SPEC_GET(DT_NODELABEL(rgb_en_l2), gpios);
static const struct gpio_dt_spec rgb_en_l3 = GPIO_DT_SPEC_GET(DT_NODELABEL(rgb_en_l3), gpios);

static const struct gpio_dt_spec rgb_enables[] = {rgb_en_0, rgb_en_1, rgb_en_2, rgb_en_3, rgb_en_4, rgb_en_5, rgb_en_6, rgb_en_7, rgb_en_8, rgb_en_9, rgb_en_l3, rgb_en_l2, rgb_en_l0, rgb_en_l1};

const struct led_rgb kabot_color = {255, 0, 72};
const struct led_rgb kabot_init = {0, 0, 255};
const struct led_rgb kabot_warning = {255, 157, 0};
const struct led_rgb kabot_error = {255, 0, 0};
const struct led_rgb kabot_ok = {0, 255, 0};
const struct led_rgb kabot_off = {0, 0, 0};

const struct led_rgb kabot_active = {255, 255, 255};
const struct led_rgb kabot_inactive = {127, 0, 36};


struct rgb {
    float r;
    float g;
    float b;
};

const struct rgb kabot_init_internal = {0.0, 0.0, 1.0};

struct rgb rgbPwmValues[] = {kabot_init_internal,
                             kabot_init_internal,
                             kabot_init_internal,
                             kabot_init_internal,
                             kabot_init_internal,
                             kabot_init_internal,
                             kabot_init_internal,
                             kabot_init_internal,
                             kabot_init_internal,
                             kabot_init_internal,
                             kabot_init_internal,
                             kabot_init_internal,
                             kabot_init_internal,
                             kabot_init_internal};


void set_leds(struct rgb* rgbPwmValues, int led_number) {

        for(int currentLedNumber = 0; currentLedNumber < led_number; currentLedNumber++){
            struct gpio_dt_spec current_led = rgb_enables[currentLedNumber];
            gpio_pin_set_dt(&current_led, 1);

            if(k_mutex_lock(&rgb_mutex, K_MSEC(100)) == 0){
                pwm_set_pulse_dt(&pwm_red, pwm_red.period * rgbPwmValues[currentLedNumber].r);
                pwm_set_pulse_dt(&pwm_green, pwm_green.period * rgbPwmValues[currentLedNumber].g);
                pwm_set_pulse_dt(&pwm_blue, pwm_blue.period * rgbPwmValues[currentLedNumber].b);

                k_mutex_unlock(&rgb_mutex);
                k_sleep(K_USEC(FLASH_TIME_US));
            }
            
            pwm_set_pulse_dt(&pwm_red, 0);
            pwm_set_pulse_dt(&pwm_green, 0);
            pwm_set_pulse_dt(&pwm_blue, 0);
            gpio_pin_set_dt(&current_led, 0);
        }
}

void led_thread(void){

    for(int i = 0; i < ALL_LEDS_NUMBER; i++){
        gpio_pin_configure_dt(&rgb_enables[i], GPIO_OUTPUT_ACTIVE);
        gpio_pin_set_dt(&rgb_enables[i], 0);
    }

    while(1) {
        set_leds(rgbPwmValues, ALL_LEDS_NUMBER);    
        k_sleep(K_MSEC(1));
    }
}

// todo: make it real driver
int led_strip_update_rgb_impl(const struct device *dev, struct led_rgb *pixels, size_t num_pixels){
    ARG_UNUSED(dev);
    int ret = 0;
    for(size_t i = 0; i < num_pixels; i++){
        
        ret = k_mutex_lock(&rgb_mutex, K_MSEC(100));
        if(ret == 0){
            rgbPwmValues[i].r = pixels[i].r * (1.0/255);
            rgbPwmValues[i].g = pixels[i].g * (1.0/255);
            rgbPwmValues[i].b = pixels[i].b * (1.0/255);
            k_mutex_unlock(&rgb_mutex);
        }else{
            LOG_WRN("Unable aquire mutex: rgb_mutex");
        }
    }

    return ret;
}

int led_strip_set_led(const struct device *dev, struct led_rgb pixel, size_t number_of_pixel){
    static struct led_rgb pixels[ALL_LEDS_NUMBER];
    pixels[number_of_pixel].r = pixel.r;
    pixels[number_of_pixel].g = pixel.g;
    pixels[number_of_pixel].b = pixel.b;

    return led_strip_update_rgb_impl(dev, pixels, ALL_LEDS_NUMBER);
}

void set_led(int number, struct led_rgb color){
    if(k_mutex_lock(&rgb_mutex, K_MSEC(100)) == 0){
        led_strip_set_led(NULL, color, number);
        k_mutex_unlock(&rgb_mutex);
    }else{
        LOG_WRN("Led mutex timeout!");
    }
}

void set_led_multi(struct led_rgb* pixels, size_t number_of_pixels, size_t offset){
    if(number_of_pixels + offset > ALL_LEDS_NUMBER){
        LOG_ERR("Too big size of led array or offset: array: %d offset: %d max: %d", number_of_pixels, offset, ALL_LEDS_NUMBER);
        return;
    }
    if(k_mutex_lock(&rgb_mutex, K_MSEC(100)) == 0){
        for(size_t i = 0; i < number_of_pixels; i++){
            led_strip_set_led(NULL, pixels[i], i+offset);
            k_mutex_unlock(&rgb_mutex);
        }
    }else{
        LOG_WRN("Led mutex timeout!");
    }
}

static struct led_rgb colors[ALL_LEDS_NUMBER];
void set_led_all(struct led_rgb color){
    for(size_t i = 0; i < ALL_LEDS_NUMBER; i++){
        colors[i].r = color.r;
        colors[i].g = color.g;
        colors[i].b = color.b;
    }
    set_led_multi(colors, ALL_LEDS_NUMBER, 0);
}

K_THREAD_DEFINE(led_thread_id, 1024, led_thread, NULL, NULL, NULL, 6, 0, 0);
```

## src/line_sensor.c
```c
#include <zephyr/drivers/adc.h>
#include <zephyr/logging/log.h>
#include <zephyr/device.h>
#include "led_strip_charlieplex.h"
#include <zephyr/drivers/gpio.h>
#include "line_sensor.h"

LOG_MODULE_REGISTER(line_sensor);

struct line_measurement line_measurements[ALL_LINE_SENSOR_NUMBER];

////////////////////////////////////////////////// ADC
#define ADC_RESOLUTION          12
#define ADC_GAIN                ADC_GAIN_1
#define ADC_REFERENCE           ADC_REF_INTERNAL
#define ADC_ACQUISITION_TIME    ADC_ACQ_TIME_DEFAULT
#define BL_RGB_OFFSET           10

#if !DT_NODE_EXISTS(DT_PATH(zephyr_user)) || \
	!DT_NODE_HAS_PROP(DT_PATH(zephyr_user), io_channels)
#error "No suitable devicetree overlay specified"
#endif

#define DT_SPEC_AND_COMMA(node_id, prop, idx) \
	ADC_DT_SPEC_GET_BY_IDX(node_id, idx),

/* Data of ADC io-channels specified in devicetree. */
static const struct adc_dt_spec adc_channels[] = {
	DT_FOREACH_PROP_ELEM(DT_PATH(zephyr_user), io_channels,
			     DT_SPEC_AND_COMMA)
};

#define LABEL_AND_COMMA(node_id, prop, idx) \
	DT_LABEL(DT_IO_CHANNELS_CTLR_BY_IDX(node_id, idx)),

/* Labels of ADC controllers referenced by the above io-channels. */
static const char *const adc_labels[] = {
	DT_FOREACH_PROP_ELEM(DT_PATH(zephyr_user), io_channels,
			     LABEL_AND_COMMA)
};

static const struct gpio_dt_spec ir_led = GPIO_DT_SPEC_GET(DT_NODELABEL(ir_led), gpios);

void adc_thread(void){

    gpio_pin_configure_dt(&ir_led, GPIO_OUTPUT_ACTIVE);
    gpio_pin_set_dt(&ir_led, 1);
    
    struct line_measurement* current_measurement;
    
    for(int i = 0; i < ALL_LINE_SENSOR_NUMBER; i++){
        // initialize ADC
        struct adc_dt_spec *dt_spec = &adc_channels[i];
        struct adc_channel_cfg channel_cfg = {
                .gain             = ADC_GAIN,
                .reference        = ADC_REFERENCE,
                .acquisition_time = ADC_ACQUISITION_TIME,
                .channel_id       = dt_spec->channel_id,
        };
        adc_channel_setup(dt_spec->dev, &channel_cfg);
        if(k_mutex_lock(&line_measurements_mutex, K_MSEC(1000)) == 0) {
            // initialize line readings
            current_measurement = &line_measurements[i];
            current_measurement->threshold = -10;
            current_measurement->white_line_detected = false;   
            k_mutex_unlock(&line_measurements_mutex);
        }
    }

    int16_t sample_buffer[1];

    struct adc_sequence sequence = {
        .buffer = sample_buffer,
        /* buffer size in bytes, not number of samples */
        .buffer_size = sizeof(sample_buffer),
        .resolution = ADC_RESOLUTION,
        .oversampling = 0,
    };
    
    int adc_readings[ALL_LINE_SENSOR_NUMBER];
    
    while(1){
        for(int i = 0; i < ALL_LINE_SENSOR_NUMBER; i++){

            struct adc_dt_spec *dt_spec = &adc_channels[i];
            sequence.channels = BIT(dt_spec->channel_id);
            gpio_pin_set_dt(&ir_led, 1);
            k_sleep(K_MSEC(1));
            adc_read(dt_spec->dev, &sequence);
            gpio_pin_set_dt(&ir_led, 0);

            adc_readings[i] = sample_buffer[0];
            adc_read(dt_spec->dev, &sequence);
            adc_readings[i] -= sample_buffer[0];

            if(k_mutex_lock(&line_measurements_mutex, K_MSEC(100)) == 0) {
                current_measurement = &line_measurements[i];
                if(adc_readings[i] < current_measurement->threshold){
                    current_measurement->white_line_detected = true;
                }else{
                    current_measurement->white_line_detected = false;
                }            
                k_mutex_unlock(&line_measurements_mutex);
            }

        }
        k_sleep(K_MSEC(1));
    }

}

#define STACKSIZE 1024
#define PRIORITY 7
K_MUTEX_DEFINE(line_measurements_mutex);
K_THREAD_DEFINE(adc_thread_id, STACKSIZE, adc_thread, NULL, NULL, NULL, PRIORITY, 0, 0);
```
